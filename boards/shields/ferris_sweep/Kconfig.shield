## boards/shields/ferris_sweep/Kconfig.shield
```kconfig
# Copyright (c) 2020 The ZMK Contributors
# SPDX-License-Identifier: MIT

config SHIELD_FERRIS_SWEEP_CENTRAL_DONGLE
    def_bool $(shields_list_contains,ferris_sweep_central_dongle)

config SHIELD_FERRIS_SWEEP_PERIPHERAL_LEFT
    def_bool $(shields_list_contains,ferris_sweep_peripheral_left)

config SHIELD_FERRIS_SWEEP_PERIPHERAL_RIGHT
    def_bool $(shields_list_contains,ferris_sweep_peripheral_right)
```
